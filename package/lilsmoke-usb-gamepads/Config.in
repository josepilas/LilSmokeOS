## package/lilsmoke-usb-gamepads/Config.in
```kconfig
config BR2_PACKAGE_LILSMOKE_USB_GAMEPADS
    bool "LilSmoke USB HIDAPI controller driver"
    depends on BR2_TOOLCHAIN_HAS_THREADS
    select BR2_PACKAGE_SDL2
    select BR2_PACKAGE_LIBUSB
    select BR2_PACKAGE_LILSMOKE_USB_TRANSPORT
    default y if BR2_PACKAGE_LILSMOKE_UI
    help
      Native gamepad input for supported HIDAPI controllers and USB dongles.
      Uses uinput where available, otherwise bounded shared gamepad state.
      It does not translate gamepads into keyboards or mouse input.
```

## package/lilsmoke-usb-transport/Config.in
```kconfig
config BR2_PACKAGE_LILSMOKE_USB_TRANSPORT
    bool "LilSmoke portable USB controller transport"
    depends on BR2_TOOLCHAIN_HAS_THREADS
    help
      Controller-private libusb with sysfs polling when the stock kernel
      has no netlink sockets, and pipe/poll instead of eventfd/timerfd.
```

## package/opendingux-emulators/Config.in
```kconfig
config BR2_PACKAGE_OPENDINGUX_EMULATORS
    bool "PocketSNES (OpenDingux/RetroFW source port)"
    depends on BR2_INSTALL_LIBSTDCPP
    depends on BR2_USE_MMU
    depends on BR2_TOOLCHAIN_HAS_THREADS
    depends on !BR2_STATIC_LIBS
    depends on !BR2_PACKAGE_SDL
    select BR2_PACKAGE_LILSMOKE_SDL12
    select BR2_PACKAGE_ZLIB
    select BR2_PACKAGE_LIBPNG
    help
      Pinned PocketSNES rebuilt for the target libc using SDL 1.2 compatibility
      over SDL2/DirectFB software rendering. No OpenGL or clock-register writes.
      PCSX4ALL is packaged independently with a native SDL2 frontend.
      Other vendored trees are unverified, not an installed 50-emulator suite.
      Stock OpenDingux OPK binaries are not musl-compatible by default.

config BR2_PACKAGE_OPENDINGUX_EMULATORS_MINIMAL
    bool
    default y if BR2_PACKAGE_OPENDINGUX_EMULATORS

config BR2_PACKAGE_OPENDINGUX_EMULATORS_DEBUG
    bool "Keep PocketSNES debug symbols"
    depends on BR2_PACKAGE_OPENDINGUX_EMULATORS
```

## package/pcsx4all/Config.in
```kconfig
config BR2_PACKAGE_PCSX4ALL
    bool "pcsx4all (native software PS1 emulator)"
    depends on BR2_mipsel && BR2_MIPS_OABI32
    depends on BR2_USE_MMU && BR2_INSTALL_LIBSTDCPP
    depends on BR2_USE_WCHAR
    depends on BR2_TOOLCHAIN_HAS_THREADS
    default n
    select BR2_PACKAGE_ZLIB
    select BR2_PACKAGE_LIBPNG
    select BR2_PACKAGE_ALSA_LIB
    select BR2_PACKAGE_SDL2
    select BR2_PACKAGE_SDL2_DIRECTFB
    select BR2_PACKAGE_SDL2_TTF
    select BR2_PACKAGE_LILSMOKE_APPS
    help
      Rebuilds the reconstructed PCSX4ALL source for this toolchain, with
      MIPS-to-MIPS dynarec, UNAI software rendering, SDL2/DirectFB display,
      native evdev input/remapping and ALSA sound. No vendor driver.so is
      loaded into the musl process. Actual-console speed remains unverified.

      Uses a user BIOS at /persist/bios/scph1001.bin when present, otherwise
      the core's HLE BIOS. HLE compatibility is game-dependent.
      Saves and states persist below /persist/{saves,states}/pcsx4all.
      Installed as the bundled PCSX4ALL LilSmoke Application, declaring
      open_core=psx, with its own native menu. Not an OpenDingux tab entry.
```

## package/portsmoke-sm64/Config.in
```kconfig
config BR2_PACKAGE_PORTSMOKE_SM64
    bool "SM64 native movement prototype .lilpck"
    depends on BR2_INSTALL_LIBSTDCPP
    depends on BR2_mipsel
    depends on BR2_TOOLCHAIN_HAS_THREADS
    select BR2_PACKAGE_HOST_PYTHON3
    select BR2_PACKAGE_SDL2
    select BR2_PACKAGE_WEBP
    help
      Independent SM64 development app: extract validated US ROM assets on
      the device, without Python, a compiler, a GPU, or bundled game data.
      Produces a bundled .lilpck in BINARIES_DIR, not a shared .peng.
      Includes a native ROM-derived Bob-omb Battlefield scene, a pinned MIT
      static CPU rasterizer, original Mario model/animations, basic movement,
      collision and jump handling. Includes a native WebP progress screen.
      Successful extraction deletes only the app's verified original ROM copy.
      Checked private caches are reused on future launches. User data and
      saves are created inside the installed independent app, never bundled.
      There is no system GL/GPU or N64 emulator. This is not the complete game;
      enemies, stars, other levels, advanced actions and audio are absent.
      This option is intentionally off by default.

comment "SM64 BYO-Data tools need a C++ toolchain"
    depends on !BR2_INSTALL_LIBSTDCPP
```

## package/portsmoke/Config.in
```kconfig
config BR2_PACKAGE_PORTSMOKE
    bool "Legacy PortSmoke compatibility helper"
    select BR2_PACKAGE_UTIL_LINUX
    select BR2_PACKAGE_UTIL_LINUX_MOUNT
    select BR2_PACKAGE_UTIL_LINUX_UMOUNT
    help
      Optional legacy helper only. New applications use .lilpck packages
      and /storage/independent-apps, not modular engine images. It launches
      CPU-only, software-rendered SDL2/DirectFB engines packaged as
      SquashFS .peng images on /storage/portsmoke.

      PortSmoke does not provide an external input mapper. Engines are
      expected to be patched or configured at build time for the target
      handheld controls.
```

## package/retroarch-mips/Config.in
```kconfig
config BR2_PACKAGE_RETROARCH_MIPS
    bool "retroarch (MIPS build) + 8 curated libretro cores"
    default y if BR2_PACKAGE_LILSMOKE_OS
    select BR2_PACKAGE_SDL2
    select BR2_PACKAGE_SDL2_DIRECTFB
    select BR2_PACKAGE_SDL2_ALSA
    select BR2_PACKAGE_ALSA_LIB
    select BR2_PACKAGE_FREETYPE
    select BR2_PACKAGE_LIBPNG
    select BR2_PACKAGE_ZLIB
    select BR2_PACKAGE_LIBEVDEV
    help
      RetroArch built for MIPS32 74Kf with the DirectFB video driver
      (no GPU on the SF3000/GB350 target).

      Ships with a curated set of 8 lightweight libretro cores appropriate
      for ~1.2 GHz MIPS + 128-256 MB RAM:
        - FCEUmm            (NES/Famicom/FDS)
        - Gambatte          (Game Boy / Game Boy Color)
        - mGBA              (Game Boy Advance)
        - Snes9x 2005       (SNES, alignment-safe MIPS software core)
        - Genesis Plus GX   (Master System / Game Gear / Mega Drive)
        - FBNeo             (Arcade: CPS1, early CPS2, early Neo Geo)
        - Beetle PCE Fast   (PC Engine / TurboGrafx-16)
        - Handy             (Atari Lynx)

      For 128 MB SKUs (LILSMOKE_LITE preset), the last 3 are dropped.

      PS1 is handled separately by the pcsx4all package (rkgame reconstruction)
      — not via a libretro core, because that port uses a MIPS-to-MIPS
      dynarec that outperforms any available libretro PS1 core on this CPU.

config BR2_PACKAGE_RETROARCH_MIPS_SNES_QA
    bool "SNES-only functional QA image"
    depends on BR2_PACKAGE_RETROARCH_MIPS
    default n
    help
      Build the RetroArch frontend but skip unrelated core downloads and
      compile only the pinned Snes9x 2005 core for the target ABI. This is
      intended for deterministic QEMU/UI recording and CI, not releases.
```

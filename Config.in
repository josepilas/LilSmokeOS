## configs/lilsmoke_gb350_defconfig
```kconfig
# LilSmokeOS — GB350 defconfig (real hardware)
#
# Unverified HiChip-family GB350 userspace profile with a 3.5" 640x480 panel.
# Real image generation is BSP-gated.
#
# Usage:
#   cd /path/to/buildroot
#   make BR2_EXTERNAL=/path/to/lilsmoke-os lilsmoke_gb350_defconfig
#   make
#   # Then flash: sudo dd if=output/images/lilsmoke-gb350.img of=/dev/sdX bs=4M
#
# See docs/hardware.md for the flashing procedure.

# --- Toolchain ---
BR2_mipsel=y
BR2_mips_32r2=y
# Keep legacy NaN encoding for stock firmware binary compatibility.
# BR2_MIPS_NAN_2008 is not set
BR2_TOOLCHAIN_BUILDROOT_GLIBC=n
BR2_TOOLCHAIN_BUILDROOT_MUSL=y
BR2_TOOLCHAIN_BUILDROOT_CXX=y
BR2_TOOLCHAIN_BUILDROOT_FORTRAN=n
BR2_KERNEL_HEADERS_6_6=y
BR2_TOOLCHAIN_BUILDROOT_USE_SSP=y

# MIPS DSP ASE
BR2_MIPS_DSP=y
BR2_MIPS_DSPR2=y

# Hard float
# BR2_MIPS_SOFT_FLOAT is not set

# --- Build options ---
BR2_OPTIMIZE_3=y
BR2_TARGET_OPTIMIZATION="-mtune=74kc -mdspr2 -mfp32 -mhard-float -mplt -mlong-calls"
BR2_ENABLE_LTO=y
BR2_GLOBAL_PATCH_DIR="$(BR2_EXTERNAL_LILSMOKE_PATH)/patches"
BR2_SSP_STRONG=y
BR2_PIC=y
BR2_RELRO_FULL=y
BR2_FORTIFY_SOURCE_2=y
BR2_INIT_BUSYBOX=y
BR2_ROOTFS_DEVICE_CREATION_DYNAMIC_MDEV=y
BR2_TARGET_GENERIC_ROOT_PASSWD=""
BR2_TARGET_GENERIC_GETTY_PORT="ttyS0"
BR2_TARGET_GENERIC_GETTY_BAUDRATE_115200=y

# --- Target device ---
BR2_LILSMOKE_TARGET_GB350=y

# --- Board support ---
# Intentionally userspace-only. No independently verified GB350 kernel DTS,
# display/audio implementation, or production boot adapter is available.

# --- Filesystem ---
BR2_TARGET_ROOTFS_CPIO=y
BR2_TARGET_ROOTFS_CPIO_GZIP=y
BR2_TARGET_ROOTFS_SQUASHFS=y
BR2_TARGET_ROOTFS_SQUASHFS4_XZ=y

# --- Userspace ---
BR2_PACKAGE_BUSYBOX=y
BR2_PACKAGE_BUSYBOX_SHOW_OTHERS=y
BR2_PACKAGE_BUSYBOX_CONFIG="$(BR2_EXTERNAL_LILSMOKE_PATH)/board/qemu-mipsel/busybox.config"

BR2_PACKAGE_E2FSPROGS=y
BR2_PACKAGE_E2FSPROGS_MKE2FS=y
BR2_PACKAGE_E2FSPROGS_RESIZE2FS=y
BR2_PACKAGE_MTD=y
BR2_PACKAGE_UTIL_LINUX=y
BR2_PACKAGE_UTIL_LINUX_MOUNT=y
BR2_PACKAGE_UTIL_LINUX_UMOUNT=y
BR2_PACKAGE_UTIL_LINUX_FALLOCATE=y
BR2_PACKAGE_P7ZIP=y
BR2_PACKAGE_P7ZIP_7ZA=y
BR2_PACKAGE_UNRAR=y

# Network
BR2_PACKAGE_IW=y
BR2_PACKAGE_WPA_SUPPLICANT=y
BR2_PACKAGE_WPA_SUPPLICANT_CLI=y
BR2_PACKAGE_WPA_SUPPLICANT_PASSPHRASE=y
BR2_PACKAGE_DROPBEAR=y
BR2_PACKAGE_DROPBEAR_DISABLE_REVERSEDNS=y

# LilSmokeOS packages
BR2_PACKAGE_LILSMOKE_OS=y
BR2_PACKAGE_LILSMOKE_APPS=y
BR2_PACKAGE_LILSMOKE_SCRIPTS=y
BR2_PACKAGE_LILSMOKE_UI=y

# --- J1: Media stack ---
BR2_PACKAGE_DIRECTFB=y
BR2_PACKAGE_DIRECTFB_MIPS=y
BR2_PACKAGE_DIRECTFB_UNIQUE_ID=y
BR2_PACKAGE_DIRECTFB_DIVINE=y
BR2_PACKAGE_DIRECTFB_JPEG=y
BR2_PACKAGE_DIRECTFB_PNG=y
BR2_PACKAGE_DIRECTFB_SDL=n
BR2_PACKAGE_DIRECTFB_SVG=n
BR2_PACKAGE_DIRECTFB_EXAMPLES=n
BR2_PACKAGE_DIRECTFB_TESTS=n
BR2_PACKAGE_DIRECTFB_GIF=y
BR2_PACKAGE_DIRECTFB_IMLIB2=n
BR2_PACKAGE_DIRECTFB_TSLIB=n
BR2_PACKAGE_DIRECTFB_X11=n
BR2_PACKAGE_DIRECTFB_DEBUG=n
BR2_PACKAGE_DIRECTFB_TRACE=n

BR2_PACKAGE_SDL2=y
BR2_PACKAGE_SDL2_DIRECTFB=y
BR2_PACKAGE_SDL2_OPENGLES=n
BR2_PACKAGE_SDL2_OPENGL=n
BR2_PACKAGE_SDL2_X11=n
BR2_PACKAGE_SDL2_WAYLAND=n
BR2_PACKAGE_SDL2_KMS=n
BR2_PACKAGE_SDL2_PIPEWIRE=n
BR2_PACKAGE_SDL2_NAS=n
BR2_PACKAGE_SDL2_ALSA=y
BR2_PACKAGE_LILSMOKE_USB_GAMEPADS=y
BR2_PACKAGE_SDL2_VIRTUAL_JOYSTICK=y

BR2_PACKAGE_ALSA_LIB=y
BR2_PACKAGE_ALSA_LIB_TOPOLOGY=n
BR2_PACKAGE_ALSA_LIB_RAWMIDI=y
BR2_PACKAGE_ALSA_LIB_HWDEP=y
BR2_PACKAGE_ALSA_LIB_SEQ=y
BR2_PACKAGE_ALSA_LIB_ALISP=n
BR2_PACKAGE_ALSA_LIB_OLD_SYMBOLS=n
BR2_PACKAGE_ALSA_UTILS=y
BR2_PACKAGE_ALSA_UTILS_ALSACTL=y
BR2_PACKAGE_ALSA_UTILS_ALSAMIXER=y
BR2_PACKAGE_ALSA_UTILS_AMIXER=y
BR2_PACKAGE_ALSA_UTILS_APLAY=y
BR2_PACKAGE_ALSA_UTILS_SPEAKER_TEST=y

BR2_PACKAGE_LIBEVDEV=y
BR2_PACKAGE_LIBPNG=y
BR2_PACKAGE_WEBP=y
BR2_PACKAGE_WEBP_DEMUX=y
BR2_PACKAGE_LIBJPEG=y
BR2_PACKAGE_LIBJPEG_TURBO=y
BR2_PACKAGE_DEJAVU=y
BR2_PACKAGE_LIBERATION=y
BR2_PACKAGE_FONTCONFIG=y
BR2_PACKAGE_FREETYPE=y

# --- J1: fbdev test app ---
BR2_PACKAGE_LILSMOKE_FBTEST=y

# --- J2: RetroArch + 8 curated MIPS cores ---
BR2_PACKAGE_RETROARCH_MIPS=y

# --- J2-extra: PCSX4ALL (rkgame reconstruction) — PS1 support ---
BR2_PACKAGE_PCSX4ALL=y
BR2_PACKAGE_OPENDINGUX_EMULATORS=y

# --- Host tools ---
BR2_PACKAGE_HOST_SQUASHFS=y
BR2_PACKAGE_HOST_MKPASSWD=y
BR2_PACKAGE_HOST_FAKETIME=y
```

## package/directfb-mips/Config.in
```kconfig
config BR2_PACKAGE_DIRECTFB_MIPS
    bool "DirectFB (LilSmokeOS framebuffer-only build)"
    default y if BR2_PACKAGE_LILSMOKE_OS
    select BR2_PACKAGE_DIRECTFB
    help
      Wrapper that enables Buildroot's stock DirectFB package with
      LilSmokeOS-specific overrides:
        - fbdev-only (no X11, no OpenGL/GLES, no multi-app core)
        - FreeType + libpng support
        - No SDL backend inside DirectFB (we use SDL2 on top)

      This is the 2D rendering layer that SDL2 sits on top of. Without
      it, SDL2 cannot create windows on the framebuffer.

      For real hardware (SF3000/GB350), J1+ will add patches that:
        - Force the E3100's specific fbdev pixel format (BGRA, 32bpp)
        - Disable unused font drivers (saves ~600 KB RSS)
        - Disable multi-application core (saves another ~400 KB)
```

## package/libvterm/Config.in
```kconfig
config BR2_PACKAGE_LIBVTERM
    bool "libvterm"
    help
      Toolkit-independent VT220/xterm terminal emulator library.
      https://www.leonerd.org.uk/code/libvterm/
```

## package/lilsmoke-apps/Config.in
```kconfig
config BR2_PACKAGE_LILSMOKE_APPS
    bool "LilSmoke Applications (.lilpck)"
    default y if BR2_PACKAGE_LILSMOKE_UI
    depends on BR2_INSTALL_LIBSTDCPP
    depends on BR2_USE_WCHAR
    depends on BR2_TOOLCHAIN_HAS_THREADS
    select BR2_PACKAGE_LIBARCHIVE
    select BR2_PACKAGE_JSON_C
    select BR2_PACKAGE_LIBSODIUM
    select BR2_PACKAGE_ZLIB
    select BR2_PACKAGE_BZIP2
    select BR2_PACKAGE_XZ
    select BR2_PACKAGE_ZSTD
    help
      Self-contained native application packages, transactional installation,
      application-owned runtimes and the LilSmoke Applications channel grid.
      ZIP, 7z and compressed TAR packages are detected by archive contents.
```

## package/lilsmoke-bluetooth/Config.in
```kconfig
config BR2_PACKAGE_LILSMOKE_BLUETOOTH
	bool "LilSmoke Bluetooth (optional)"
	depends on BR2_USE_MMU
	depends on BR2_USE_WCHAR
	depends on BR2_INSTALL_LIBSTDCPP
	depends on BR2_TOOLCHAIN_HAS_THREADS_NPTL
	depends on !BR2_STATIC_LIBS
	depends on BR2_TOOLCHAIN_HEADERS_AT_LEAST_3_18
	depends on BR2_TOOLCHAIN_GCC_AT_LEAST_4_9
	depends on BR2_TOOLCHAIN_HAS_SYNC_4
	select BR2_PACKAGE_BLUEZ5_UTILS
	select BR2_PACKAGE_BLUEZ5_UTILS_PLUGINS_HID
	select BR2_PACKAGE_BLUEZ_ALSA
	help
	  Optional BlueZ HID/HOG and BlueALSA SBC audio with native pairing UI.
	  Off at runtime by default. Requires a supported Bluetooth adapter,
	  its board/USB driver and firmware. No PulseAudio, X11 or GPU required.
	  Bond keys stay on /persist, outside the USB-exported ROM partition.
	  A2DP headphones/speakers and HSP/HFP audio endpoints are exposed;
	  microphone use depends on an application's capture support.
```

## package/lilsmoke-fbtest/Config.in
```kconfig
config BR2_PACKAGE_LILSMOKE_FBTEST
    bool "lilsmoke-fbtest (framebuffer test app)"
    default y if BR2_PACKAGE_LILSMOKE_OS
    select BR2_PACKAGE_LIBPNG
    select BR2_PACKAGE_ZLIB
    help
      Tiny (~12 KB) framebuffer test app that:
        1. Opens /dev/fb0 and queries its geometry
        2. Loads assets/logo/lilsmoke-logo.webp OR a built-in fallback PNG
        3. Centers it on the framebuffer using direct mmap
        4. Prints the box dimensions and pixel format
        5. Waits 10 seconds, then exits

      This is the J1 smoke test for the fbdev stack. No SDL2, no
      DirectFB — just the raw Linux framebuffer API. Proves the
      kernel fbdev driver works before we stack anything on top.

      Build-time location: /usr/bin/lilsmoke-fbtest
      Runtime usage:      run from a tty (e.g. tty1)
```

## package/lilsmoke-ffmpeg/Config.in
```kconfig
config BR2_PACKAGE_LILSMOKE_FFMPEG
    bool "LilSmoke FFmpeg tools and software media libraries"
    depends on BR2_TOOLCHAIN_HAS_THREADS
    depends on !BR2_STATIC_LIBS
    select BR2_PACKAGE_ZLIB
    help
      FFmpeg and ffprobe with software codecs, filters, local files and pipes.
      Includes the libraries used by the native media player. No GPU, network
      protocols, graphical ffplay dependency or background media services.
```

## package/lilsmoke-gamepads/Config.in
```kconfig
config BR2_PACKAGE_LILSMOKE_GAMEPADS
    bool "LilSmokeOS controller profiles"
    default y if BR2_PACKAGE_RETROARCH_MIPS
    help
      Pinned RetroArch Linux joystick and SDL2 fallback profiles.
      Generic pads additionally get profiles from their actual joydev
      descriptors at UI startup. No background input mapper is used.
```

## package/lilsmoke-libretro-extra/Config.in
```kconfig
config BR2_PACKAGE_LILSMOKE_LIBRETRO_EXTRA
    bool "LilSmoke optional software libretro cores"
    depends on BR2_mipsel && BR2_TOOLCHAIN_USES_MUSL
    depends on BR2_INSTALL_LIBSTDCPP
    select BR2_PACKAGE_RETROARCH_MIPS
    help
      Source-pinned MIPS32r2 software cores. The payload is emitted under
      images/emulator-expansion/emulators/libretro for the LILROMS partition,
      not installed into the limited LILOS runtime. No game data is included.
      Newly added systems are visible only with an installed native equivalent.
```

## package/lilsmoke-media/Config.in
```kconfig
config BR2_PACKAGE_LILSMOKE_MEDIA
    bool "LilSmoke music, video and photo players"
    default y if BR2_PACKAGE_LILSMOKE_UI
    depends on BR2_INSTALL_LIBSTDCPP && BR2_TOOLCHAIN_HAS_THREADS
    depends on !BR2_STATIC_LIBS
    select BR2_PACKAGE_LILSMOKE_FFMPEG
    select BR2_PACKAGE_SDL2
    select BR2_PACKAGE_SDL2_IMAGE
    select BR2_PACKAGE_SDL2_TTF
    help
      Controller-friendly local-file playback from LilSmoke Explorer.
      Bounded software decoding, playlists, seek, shuffle, repeat,
      photo zoom/rotation and the native M8 PCM output adapter.
```

## package/lilsmoke-n64/Config.in
```kconfig
config BR2_PACKAGE_LILSMOKE_N64
    bool "LilSmokeOS N64 software core (experimental)"
    depends on BR2_mipsel
    depends on BR2_MIPS_OABI32
    depends on !BR2_SOFT_FLOAT
    depends on BR2_MIPS_FP32_MODE_32 || BR2_MIPS_FP32_MODE_XX
    depends on !BR2_STATIC_LIBS
    depends on BR2_USE_MMU
    depends on BR2_TOOLCHAIN_HAS_THREADS
    depends on BR2_INSTALL_LIBSTDCPP
    depends on BR2_PACKAGE_RETROARCH_MIPS
    depends on !BR2_PACKAGE_LILSMOKE_LITE
    help
      Pinned ParaLLEl-N64 cached interpreter with Angrylion software RDP
      and automatic HLE/Cxd4 software RSP. Cartridge games only (no 64DD).
      No OpenGL, GLES, Vulkan or GPU dependencies.
      Not enabled by default: N64 is very expensive on a single 1.2 GHz
      MIPS core, and playable commercial-game performance is unverified.
      No ROMs are included. Uses the existing SDL2/DirectFB RetroArch.
```

## package/lilsmoke-od-consoles/Config.in
```kconfig
config BR2_PACKAGE_LILSMOKE_OD_CONSOLES
	bool "LilSmoke native console staging"
	depends on BR2_mipsel && BR2_TOOLCHAIN_USES_MUSL
	depends on BR2_INSTALL_LIBSTDCPP && BR2_TOOLCHAIN_HAS_THREADS
	select BR2_PACKAGE_LILSMOKE_OD_SDL
	select BR2_PACKAGE_SDL2
	select BR2_PACKAGE_ZLIB
	select BR2_PACKAGE_LIBPNG
	help
	  Pinned standalone SDL console executables. Builds isolated optional
	  storage payloads only; never installs into the Buildroot target.
```

## package/lilsmoke-od-engines/Config.in
```kconfig
config BR2_PACKAGE_LILSMOKE_OD_ENGINES
	bool "LilSmoke native classic SDL engines"
	depends on BR2_mipsel
	depends on BR2_INSTALL_LIBSTDCPP
	depends on BR2_TOOLCHAIN_HAS_THREADS
	select BR2_PACKAGE_LILSMOKE_OD_SDL
	select BR2_PACKAGE_SDL2_IMAGE
	select BR2_PACKAGE_SDL2_MIXER
	select BR2_PACKAGE_LIBPNG
	select BR2_PACKAGE_JPEG
	select BR2_PACKAGE_FREETYPE
	select BR2_PACKAGE_PIXMAN
	select BR2_PACKAGE_FMT
	help
	  Pinned NXEngine-Evo, PrBoom-Plus, EasyRPG Player and curated
	  two-dimensional ScummVM, standalone mGBA and legacy 32-bit OpenBOR.
	  No game content, OpenGL, GLES or Vulkan.
	  Native entries open app-owned menus without a ROM argument.

config BR2_PACKAGE_LILSMOKE_OD_MAME4ALL
	bool "MAME4ALL (noncommercial personal build)"
	depends on BR2_PACKAGE_LILSMOKE_OD_ENGINES
	default n
	help
	  Original GCW0 MAME4ALL for matching 0.37b5 ROM sets. Upstream
	  components have noncommercial restrictions; not enabled in
	  the general image by default. No ROMs or samples are bundled.
```

## package/lilsmoke-od-sdl/Config.in
```kconfig
config BR2_PACKAGE_LILSMOKE_OD_SDL
	bool "LilSmoke native SDL OpenDingux adapter"
	depends on BR2_mipsel
	depends on BR2_INSTALL_LIBSTDCPP
	depends on BR2_TOOLCHAIN_HAS_THREADS
	select BR2_PACKAGE_SDL2
	select BR2_PACKAGE_LILSMOKE_SDL12
	help
	  Real stock-M8 PCM, shared evdev/touchpad input and engine hotkeys.
	  Public SDL1.2 and SDL2 APIs; enabled only on verified hcfb hardware.
```

## package/lilsmoke-opendingux/Config.in
```kconfig
config BR2_PACKAGE_LILSMOKE_OPENDINGUX
	bool "lilsmoke native OpenDingux catalog/runtime"
	depends on BR2_mipsel
	select BR2_PACKAGE_LILSMOKE_SQFS
	select BR2_PACKAGE_LIBSODIUM
	help
	  Bounded native MIPS/musl OPK catalog and streaming extraction.
	  No loop/FUSE, shell Exec evaluation or legacy ABI emulation.
```

## package/lilsmoke-scripts/Config.in
```kconfig
config BR2_PACKAGE_LILSMOKE_SCRIPTS
    bool "lilsmoke-scripts"
    depends on BR2_USE_WCHAR
    depends on BR2_INSTALL_LIBSTDCPP
    depends on BR2_TOOLCHAIN_HAS_THREADS
    default y if BR2_PACKAGE_LILSMOKE_OS
    select BR2_PACKAGE_P7ZIP
    select BR2_PACKAGE_P7ZIP_7ZA
    select BR2_PACKAGE_DROPBEAR
    select BR2_PACKAGE_DOSFSTOOLS
    select BR2_PACKAGE_DOSFSTOOLS_MKFS_FAT
    select BR2_PACKAGE_DOSFSTOOLS_FSCK_FAT
    select BR2_PACKAGE_EXFATPROGS
    select BR2_PACKAGE_E2FSPROGS
    select BR2_PACKAGE_SDL
    select BR2_PACKAGE_SDL2
    select BR2_PACKAGE_JSON_C
    help
      LilSmokeOS runtime helper scripts (init.d, mdev hotplug,
      OTA unpacker, WiFi/SSH configurator, and capability-gated USB
      RNDIS/mass-storage gadget service). These are POSIX shell, no
      Python, no Perl.
```

## package/lilsmoke-sdl12/Config.in
```kconfig
config BR2_PACKAGE_LILSMOKE_SDL12
    bool "SDL 1.2 compatibility over SDL2"
    depends on BR2_TOOLCHAIN_HAS_THREADS
    depends on !BR2_STATIC_LIBS
    depends on !BR2_PACKAGE_SDL
    select BR2_PACKAGE_SDL2
    help
      Rebuilt SDL 1.2 API for compatible source ports; the video stack remains
      SDL2/DirectFB software rendering. Not binary libc compatibility.
```

## package/lilsmoke-sqfs/Config.in
```kconfig
config BR2_PACKAGE_LILSMOKE_SQFS
	bool "lilsmoke bounded libsquashfs"
	select BR2_PACKAGE_ZLIB
	select BR2_PACKAGE_XZ
	help
	  Squashfs-tools-ng 1.2.0 streaming library only, with allocation
	  and XZ decoder limits for the single-CPU 128 MiB M8.
```

## package/lilsmoke-syspck/Config.in
```kconfig
config BR2_PACKAGE_LILSMOKE_SYSPCK
    bool "LilSmoke System Packages (.syspck)"
    depends on BR2_USE_MMU
    depends on BR2_USE_WCHAR
    depends on BR2_INSTALL_LIBSTDCPP
    depends on !BR2_STATIC_LIBS
    select BR2_PACKAGE_LILSMOKE_SCRIPTS
    select BR2_PACKAGE_LIBARCHIVE
    select BR2_PACKAGE_XZ
    select BR2_PACKAGE_DTC
    select BR2_PACKAGE_LIBSODIUM
    default y if BR2_PACKAGE_LILSMOKE_OS
    help
      Signed, bounded 7z hardware/profile packages. Native C++17;
      no Python runtime, scripts inside packages or live DTB writes.
      Hardware activation requires a separately verified boot adapter.
```
